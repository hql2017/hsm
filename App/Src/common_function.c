/*
 * common_function.c
 *
 *  Created on: Apr 10, 2025
 *      Author: Hql2017
 */

#include "common_function.h" 

/**************************PID*************************/

void pid_init(PID_ControlBlock *pid )
{
	pid->set_value = 0.0;
	pid->actual_value = 0.0;
	pid->error = 0.0;
	pid->error_next = 0.0;
	pid->error_last = 0.0;
	//可调节PID 参数。使跟踪曲线慢慢接近阶跃函数200.0 // 
	pid->kp = 0.2;
	pid->ki = 0.01;
	pid->kd = 0.2;	
}

/* 函数功能：位置式PID控制器 
*入口参数：measureValue，反馈值，目标位置 返回 值：
*pwm=Kp*e(k)+Ki*∑e(k)+Kd[e（k）-e(k-1)] e(k)代表本次偏差 e(k-1)代表上一次的偏差 ∑e(k)代表e(k)以及之前的偏差的累积和;
*其中k为1,2,,k; pwm代表输出 
*/
int Position_PID (PID_ControlBlock *pid,int feedbackValue,int target)
{  	
	static float Bias,out,Integral_bias,Last_Bias;
	Bias=target-feedbackValue;                                  //计算偏差
	Integral_bias+=Bias;	                                //求出偏差的积分
	if(Integral_bias>3000)Integral_bias=3000;
	if(Integral_bias<-3000)Integral_bias=-3000;
	out=pid->kp*Bias+pid->ki*Integral_bias+pid->kd*(Bias-Last_Bias);       //位置式PID控制器
	Last_Bias=Bias;                                       //保存上一次偏差 
	return out;                                           //增量输出
}
/* 函数功能：增量式*
*/
float pid_realise_updata(PID_ControlBlock *pid,float speed)
{ 
	pid->set_value = speed;//设置目标值
	pid->error = pid->set_value - pid->actual_value;
	float increment_speed;//增量
	increment_speed = pid->kp*(pid->error-pid->error_next)+pid->ki*pid->error+\
	pid->kd*(pid->error-2*pid->error_next+pid->error_last);//增量计算公式 
	pid->set_value+= increment_speed;
	pid->error_last = pid->error_next;//下一次迭代 
	pid->error_next = pid->error;
	return pid->actual_value; 
}

/**************************PID*************************/
/*************************************** *//*
CRC16——modbus
uint16_t crc_table_list[256]=
{0x40BF,0x807E,

}

/****
  * @brief 找出最大值
  * @param dataBuff
  * @note   
  * @retval Max value
  */
 unsigned  short int match_max(unsigned  short int *dataBuff,unsigned  short int length )
 {
	unsigned  short int maxValue,i;	
	if(length<1) return 0;	
	maxValue=0;	
	for(i=0;i<length;i++)
	{		
		if(maxValue<dataBuff[i])
		{
			maxValue = dataBuff[i];	
		}			
	}	
	return maxValue;
} 
/****
  * @brief MAAX->MIN，冒泡排序
  * @param dataBuff
  * @note   
  * @retval None
  */
 void sord_data(unsigned  short int *dataBuff,unsigned  short int length,unsigned char flag )
 {
	unsigned  short int tempValue=0,i,j;	
	for(j=0;j+1<length;j++)
	{
		for(i=0;i+j+1<length;i++)
		{
			if(flag==0)//min->MAX
			{
				if(dataBuff[i]>dataBuff[i+1])
				{
					tempValue = dataBuff[i];				
					dataBuff[i]= dataBuff[i+1];
					dataBuff[i+1]=tempValue;
				}				
			}
			else
			{
				if(dataBuff[i]<dataBuff[i+1])
				{
					tempValue = dataBuff[i];				
					dataBuff[i]= dataBuff[i+1];
					dataBuff[i+1]=tempValue;
				}				
			}
		}
	}		
} //初始化滤波器
void kalman_filter_init(KalmanFilter* kf, double initial_estimate, double variance) {
    kf->last_estimate = initial_estimate;
    kf->estimate = initial_estimate;
    kf->variance = variance;
    kf->kalman_gain = 0.0;
    kf->error_estimate = 1.0;
} 

// 更新滤波器状态
double kalman_filter_update(KalmanFilter* kf, double measurement) {
    // 计算卡尔曼增益
    kf->kalman_gain = kf->error_estimate / (kf->error_estimate + kf->variance);
    // 更新误差估计值
    kf->error_estimate = (1 - kf->kalman_gain) * kf->error_estimate + kf->kalman_gain * (measurement - kf->last_estimate);
    // 更新估计值
    kf->estimate = kf->last_estimate + kf->kalman_gain * (measurement - kf->last_estimate);
    // 更新上次估计值
    kf->last_estimate = kf->estimate;
    return kf->estimate;
}


/**************************补码 */
  short int bm_u16( unsigned short int data)
{
	short int ret_v;
	if(data<32768)
	{
		ret_v=-data;
		//ret_v=(~data)+1;
	}	
	return ret_v ;
}

 void DWT_Init(void)
{
    CoreDebug->DEMCR|=CoreDebug_DEMCR_TRCENA_Msk;
    DWT->CYCCNT=0;
    DWT->CTRL|=DWT_CTRL_CYCCNTENA_Msk;
}       

 void delay_us(volatile unsigned int nus)
{   
    volatile unsigned int start=DWT->CYCCNT,tcnt = 0;        //刚进入时的计数器值   
    volatile unsigned int ticks=nus*(SystemCoreClock/1000000);//nus需要的节拍数 
    while(tcnt<ticks)
    {
        tcnt=  DWT->CYCCNT- start;
    }                                   
}
void delay_ms(volatile uint32_t nms)
{   
    #if 1
    HAL_Delay(nms);
    #else
    while(nms--)
    {
        delay_us(1000);
    }    
    #endif                                
}
//返回HAL_OK表示无变化
HAL_StatusTypeDef compare_buff_no_change(unsigned char *buff1,unsigned char *buff2,unsigned int length)
{   
	HAL_StatusTypeDef ret=HAL_OK;
	for(unsigned int i=0;i<length;i++)
	{
		if(buff1[i]!=buff2[i])
		{
			ret=HAL_ERROR;
			break;
		}
	}	
  return ret;                        
}
// CRC32校验函数,LSB
unsigned  int crc32_MPEG(unsigned char *pData,unsigned  int length)
{
	uint32_t crc = 0xFFFFFFFF;// 初始值
	uint32_t CRC32_POLY=0xEDB88320; // 多项式0x04C11DB7的反码
    for (int i = 0; i < length; i++) 
	{
        crc ^= pData[i]; // 将当前字节与CRC寄存器进行XOR
        for (int j = 0; j < 8; j++) 
		{
            if (crc & 1) 
			{ // 如果最低位是1
                crc = (crc >> 1) ^ CRC32_POLY; // 右移一位后与多项式进行XOR
            } 
			else 			
			{
                crc >>= 1; // 否则只右移一位
            }
        }
    }	
	return crc;
}
// 和校验函数
 unsigned int sumCheck(unsigned char *pData,unsigned  int length)
{
 unsigned  int sum;
	for (int i = 0; i < length; i++)
	{
		sum+=pData[i];
	}
	return sum;
}
// CRC校验函数,LSB
 unsigned short int crc16Num(unsigned char *pData,unsigned  int length)
{
	uint16_t crc = 0xFFFF;	
	for (int i = 0; i < length; i++)
	{
		crc ^= pData[i];			
		for (int j = 0; j < 8; j++)
		{
			if (crc & 1)
			{
				crc >>= 1;
				crc ^= 0xA001;			
			}
			else
			{
				crc >>= 1;
			}
		}
	}
	return crc;
}
#if 0
uint16_t crc16_modbus(const  uint8_t *data, uint16_t len)
{  
	uint16_t crc = 0xFFFF;  // 初始值
	for (size_t pos = 0; pos < len; pos++) 
	{
		crc ^= (uint16_t)data[pos];  // XOR输入字节到CRC寄存器
		for (uint8_t i = 8; i != 0; i--) 
		{  // 处理每个字节的每一位
			if ((crc & 0x0001) != 0) 
			{  //如果最低位是1
				crc >>= 1;
				crc ^= 0xA001;
			} 
			else 
			{
				crc >>= 1;
			}
		}
	}
	//最终结果需要再次进行反转，因为Modbus协议要求最终的CRC是高字节在前，低字节在后
	return  (crc << 8) | (crc >> 8);
	
}
#endif
const unsigned char CRCTABH[256]={
	0x00, 0xC1, 0x81, 0x40, 0x01, 0xC0, 0x80, 0x41, 0x01, 0xC0,  
	0x80, 0x41, 0x00, 0xC1, 0x81, 0x40, 0x01, 0xC0, 0x80, 0x41,  
	0x00, 0xC1, 0x81, 0x40, 0x00, 0xC1, 0x81, 0x40, 0x01, 0xC0,  
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	0x80, 0x41, 0x00, 0xC1, 0x81, 0x40 
}; 
 
const unsigned char CRCTABL[256]={
	0x00, 0xC0, 0xC1, 0x01, 0xC3, 0x03, 0x02, 0xC2, 0xC6, 0x06,  
	0x07, 0xC7, 0x05, 0xC5, 0xC4, 0x04, 0xCC, 0x0C, 0x0D, 0xCD,  
	0x0F, 0xCF, 0xCE, 0x0E, 0x0A, 0xCA, 0xCB, 0x0B, 0xC9, 0x09,  
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	0x43, 0x83, 0x41, 0x81, 0x80, 0x40 
}; 


unsigned short CRC16_TABLE_Check(unsigned char *str, unsigned short len)
{ 
	unsigned short index,crch,crcl;
	unsigned short i;
	unsigned short crc;

	crch = 0xFF; 
	crcl = 0xFF; 

	for(i = 0; i < len; i++)
	{ 
	index = crch^str[i];  
	crch  = crcl^CRCTABH[index]; 
	crcl  = CRCTABL[index];     
	} 
	crc = crch<<8 | crcl; 
	return crc; 
} 